## build/Kconfig/boards/Kconfig.defconfig
```kconfig
# Load Zephyr board defconfig descriptions.
osource "C:/Users/alvar/zephyrproject/zephyr/boards/st/nucleo_wl55jc/Kconfig.defconfig"
```

## build/Kconfig/boards/Kconfig.sysbuild
```kconfig
# Load Sysbuild board Kconfig descriptions.
osource "C:/Users/alvar/zephyrproject/zephyr/boards/st/nucleo_wl55jc/Kconfig.sysbuild"
```
